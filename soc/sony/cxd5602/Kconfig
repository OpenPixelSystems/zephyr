## soc/sony/cxd5602/Kconfig
```kconfig
# Copyright (c) 2024 Open Pixel Systems
# SPDX-License-Identifier: Apache-2.0

config SOC_SONY_CXD56XX
	select ARM
	select CPU_CORTEX_M4
	select PLATFORM_SPECIFIC_INIT
	select CPU_HAS_ARM_MPU
```

## soc/sony/cxd5602/Kconfig.defconfig
```kconfig
# Copyright (c) 2024 Open Pixel Systems
# SPDX-License-Identifier: Apache-2.0

if SOC_SONY_CXD56XX

config NUM_IRQS
	default 128

config SYS_CLOCK_HW_CYCLES_PER_SEC
	default 24000000

endif # SOC_SONY_CXD56XX
```

## soc/sony/cxd5602/Kconfig.soc
```kconfig
# Copyright (c) 2024 Open Pixel Systems
# SPDX-License-Identifier: Apache-2.0

config SOC_SONY_CXD56XX
	bool

config SOC
	default "cxd5602" if SOC_SONY_CXD56XX
```
